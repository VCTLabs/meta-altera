## conf/machine/arria10.conf
```bitbake
#@TYPE: Machine
#@NAME: arria5
#@DESCRIPTION: Machine configuration for the Arria 10 SoC" 

require conf/machine/include/socfpga.inc

UBOOT_MACHINE = "socfpga_arria10_defconfig"

EXTRA_IMAGECMD_jffs2 = "--squash -s 256 -e 64KiB"
```

## conf/machine/arria5.conf
```bitbake
#@TYPE: Machine
#@NAME: arria5
#@DESCRIPTION: Machine configuration for the Arria V SoC" 

require conf/machine/include/socfpga.inc

PREFERRED_VERSION_u-boot-socfpga = "2013.01.01"

UBOOT_MACHINE = "socfpga_arria5"

KMACHINE = "arria5"

# Default kernel devicetrees
KERNEL_DEVICETREE_arria5 ?= "socfpga_arria5_socdk.dtb"

# Add support for SDCARD creation
IMAGE_CLASSES += "image_types_socfpga"
```

## conf/machine/cyclone5.conf
```bitbake
#@TYPE: Machine
#@NAME: cyclone5
#@DESCRIPTION: Machine configuration for the Cyclone V SoC" 

require conf/machine/include/socfpga.inc

PREFERRED_VERSION_u-boot-socfpga ?= "2013.01.01"

UBOOT_MACHINE ?= "socfpga_cyclone5_config"

KMACHINE = "cyclone5"

# Default kernel devicetrees
KERNEL_DEVICETREE ?= "socfpga_cyclone5_socdk.dtb socfpga_cyclone5_sockit.dtb socfpga_cyclone5_socrates.dtb socfpga_cyclone5_de0_sockit.dtb"

# Add support for SDCARD creation
IMAGE_CLASSES += "image_types_socfpga"
```
